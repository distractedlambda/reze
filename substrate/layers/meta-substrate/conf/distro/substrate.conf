## substrate/layers/meta-substrate/conf/distro/substrate.conf
```bitbake
DISTRO = "substrate"
DISTRO_NAME = "Substrate"
DISTRO_VERSION = "0.0.1"

DISTRO_FEATURES ?= "\
    acl \
    alsa \
    bluetooth \
    ipsec \
    ipv4 \
    ipv6 \
    keyboard \
    nls \
    opengl \
    pci \
    usbhost \
    vfat \
    vulkan \
    wifi \
    xattr \
    "

TCLIBCAPPEND = ""

TCLIB ?= "glibc"

PACKAGE_CLASSES ?= "package_rpm"

require conf/distro/include/no-static-libs.inc

BB_SIGNATURE_HANDLER ?= "OEEquivHash"
BB_HASHSERVE ??= "auto"

LOCALE_UTF8_ONLY ?= "1"

INIT_MANAGER = "sysvinit"
```

## substrate/layers/meta-substrate/conf/layer.conf
```bitbake
# We have a conf and classes directory, add to BBPATH
BBPATH .= ":${LAYERDIR}"

BBFILES += "${LAYERDIR}/recipes-*/*/*.bb \
            ${LAYERDIR}/recipes-*/*/*.bbappend"

BBFILE_COLLECTIONS += "substrate"
BBFILE_PATTERN_substrate = "^${LAYERDIR}/"
BBFILE_PRIORITY_substrate = "6"

LAYERDEPENDS_substrate = "core"
LAYERSERIES_COMPAT_substrate = "mickledore"
```
